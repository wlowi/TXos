
#include "LcdWidget.h"

#define XY_TO_I( x, y) (x + y * width)

#define FONT_H (8 * fontSz)
#define FONT_W (6 * fontSz)

/* 128 pixel, Base font height 8
 *   8 * 16 = 128
 *  16 *  8 = 128
 *  32 *  4 = 128
 */
static const unsigned int lines[] =  { 0, 16, 8, 4 };

/* 160 pixel, Base font width 6
 *   6 * 26 = 156
 *  12 * 13 = 156
 *  24 *  6 = 144
 */
static const unsigned int columns[] = { 0, 26, 13, 6 };

/* standard ascii 5x7 font */
static const unsigned char  font5x7[] = {
    0x00, 0x00, 0x00, 0x00, 0x00,   
    0x3E, 0x5B, 0x4F, 0x5B, 0x3E, 	
    0x3E, 0x6B, 0x4F, 0x6B, 0x3E, 	
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    0x00, 0x00, 0x00, 0x00, 0x00, 
};

LcdWidget::LcdWidget( wxWindow *parent, wxWindowID id, unsigned int width, unsigned int height, unsigned int pixSz)
    : wxPanel( parent, id, wxDefaultPosition, wxSize(width*pixSz,height*pixSz))
{
    this->width = width;
    this->height = height;
    this->pixSz = pixSz;
    textX = 0; // text cursor position
    textY = 0;
    buffer = new pixel[width*height];

    Connect(wxEVT_PAINT, wxPaintEventHandler(LcdWidget::OnPaint));
    Connect(wxEVT_SIZE, wxSizeEventHandler(LcdWidget::OnSize)); 

    setFg( 255, 255, 255);
    setBg( 0, 0, 0);
    setFontSize( 1);
    clear();
}

void LcdWidget::OnSize( wxSizeEvent& event)
{
    Refresh();
}

void LcdWidget::OnPaint( wxPaintEvent& event)
{
    unsigned int x;
    unsigned int y;
    pixel col565 = buffer[0];

    wxPaintDC dc(this);
    dc.SetLogicalScale( pixSz, pixSz);

    wxColor col = col565ToCol( col565);
    dc.SetPen(wxPen(col));
    dc.SetBrush(wxBrush(col));

    for( x=0; x<width; x++) {
        for( y=0; y<height; y++) {

            if( col565 != buffer[ XY_TO_I(x,y) ]) {
                col565 = buffer[ XY_TO_I(x,y) ];
                col = col565ToCol( col565);
                dc.SetPen(wxPen(col));
                dc.SetBrush(wxBrush(col));
            }

            setPixelOnDC( dc, x, y);
        }
    }
}

void LcdWidget::clear()
{
    unsigned int x;
    unsigned int y;

    for( x=0; x<width; x++) {
        for( y=0; y<height; y++) {
            buffer[ XY_TO_I(x,y) ] = bgCol565;
        }
    }

    textX = textY = 0;
    
    Refresh();
}

void LcdWidget::clearEOL()
{
    unsigned int x;
    unsigned int y;

    for( x=textX; x<width; x++) {
        for( y=textY; y<textY + (8*fontSz); y++) {
            buffer[ XY_TO_I(x,y) ] = bgCol565;
        }
    }
    
    Refresh();
}

void LcdWidget::setBg( unsigned char r, unsigned char g, unsigned char b)
{
    bgCol565 = rgbToCol565( r, g ,b);
    bgCol = wxColor( r, g, b);
}

void LcdWidget::setFg( unsigned char r, unsigned char g, unsigned char b)
{
    fgCol565 = rgbToCol565( r, g ,b);
    fgCol = wxColor( r, g, b);
}

void LcdWidget::setFontSize( unsigned int sz)
{
    if( sz < 1) { fontSz = 1; }
    else if( sz > 3) { fontSz = 3; }
    else { fontSz = sz; }
}

unsigned int LcdWidget::getLines() {

    return lines[fontSz];
}

unsigned int LcdWidget::getColumns() {

    return columns[fontSz];
}

void LcdWidget::setCursor( unsigned int r, unsigned int c)
{
    textX = c * FONT_W;
    textY = r * FONT_H;

    if( textX > width) { textX = width; }
    if( textY > height) { textY = height; }
}

void LcdWidget::setRow( unsigned int r)
{
    textY = r * FONT_H;
    if( textY > height) { textY = height; }
}

void LcdWidget::setColumn( unsigned int c)
{
    textX = c * FONT_W;
    if( textX > width) { textX = width; }
}

void LcdWidget::setPixel( unsigned int x, unsigned int y)
{
    if( x >= width || y >= height) {
        return;
    }

    wxClientDC dc(this);
    dc.SetLogicalScale( pixSz, pixSz);

    dc.SetPen(wxPen(fgCol));
    dc.SetBrush(wxBrush(fgCol));

    buffer[ XY_TO_I(x,y) ] = fgCol565;
    setPixelOnDC( dc, x, y);    
}

void LcdWidget::setPixel( unsigned int x, unsigned int y, unsigned char r, unsigned char g, unsigned char b)
{
    if( x >= width || y >= height) {
        return;
    }

    wxClientDC dc(this);
    dc.SetLogicalScale( pixSz, pixSz);

    pixel col565 = rgbToCol565( r, g, b);
    wxColor col = wxColor( r, g, b);

    dc.SetPen(wxPen(col));
    dc.SetBrush(wxBrush(col));

    buffer[ XY_TO_I(x,y) ] = col565;
    setPixelOnDC( dc, x, y);
}

void LcdWidget::print( const char str[])
{
    if( str == NULL) {
        return;
    }

    wxClientDC dc(this);
    dc.SetLogicalScale( pixSz, pixSz);

    while( *str != '\0') {
        printChar( dc, *str);
        str++;
    }
}

void LcdWidget::println( const char str[])
{
    print( str);
    println();
}

void LcdWidget::println() {

    textX = 0;
    textY += FONT_H;
    textY = (textY > height) ? height: textY;
}

void LcdWidget::printInt( int val) {

  printInt( val, 0, ' ');
}

void LcdWidget::printInt( int val, uint8_t width) {

  printInt( val, width, ' ');
}

void LcdWidget::printInt( int val, uint8_t width, char filler) {

  int8_t neg = 0;
  unsigned int uval;

  if( val < 0) {
    uval = -val;
    neg = 1;
  } else {
    uval = val;
  }
  
  printIntGeneric( uval, neg, width, 0, filler);
}

void LcdWidget::printUInt( unsigned int val) {

  printIntGeneric( val, 0, 0, 0, ' ');
}

void LcdWidget::printUInt( unsigned int val, uint8_t width) {
  
  printIntGeneric( val, 0, width, 0, ' ');
}

void LcdWidget::printUInt( unsigned int val, uint8_t width, char filler) {
  
  printIntGeneric( val, 0, width, 0, filler);
}

void LcdWidget::printStr( const char str[], uint8_t width) {

    printStr( str, width, -1);
}

void LcdWidget::printStr( const char str[], uint8_t width, int8_t editIdx) {

  int8_t p = 0;

  if( !str) { return; }
  
  wxClientDC dc(this);
  dc.SetLogicalScale( pixSz, pixSz);

  while( str[p] && p < width) {
    if( p == editIdx) {
        saveColors();
        selectedColors();
    }
    printChar(dc,str[p]);
    if( p == editIdx) {
        restoreColors();
    }
    p++;
  }

  while( p < width) {
    printChar(dc,' ');
    p++;
  }
}

void LcdWidget::printFloat16( float16 val, uint8_t width) {

  printIntGeneric( val, 0, width, 2, ' ');
}

/* private */

void LcdWidget::setPixelOnDC( wxDC &dc, unsigned int x, unsigned int y)
{
    dc.DrawRectangle( x, y, 1, 1);
}

pixel LcdWidget::colToCol565( const wxColor &col)
{
    pixel col565 = ((col.Red() >> 3) << 11)
                 | ((col.Green() >> 2) << 5)
                 | (col.Blue() >> 3);

    return col565;
}

pixel LcdWidget::rgbToCol565( unsigned char r, unsigned char g, unsigned char b)
{
  pixel col565 = ((r >> 3) << 11)
               | ((g >> 2) << 5)
               | (b >> 3);

  return col565;  
}

wxColor LcdWidget::col565ToCol( pixel col565)
{
    unsigned char r = ((col565 >> 11) & 0x1f) << 3;
    unsigned char g = ((col565 >> 5) & 0x3f) << 2;
    unsigned char b = (col565 & 0x1f) << 3;

    return wxColor( r, g, b);
}

void LcdWidget::printChar( wxDC &dc, char ch)
{
    unsigned int x;
    unsigned int sz;

    for( x = 0; x < 5; x++) {
        for( sz = 0; sz < fontSz; sz++) {
            if( textX >= width) { break; }
            charLine( dc, font5x7[ 5 * ((unsigned char)ch) + x ]);
        }
    }

    for( sz = 0; sz < fontSz; sz++) {
        charLine( dc, 0); // Gap to next character
    }
}

void LcdWidget::charLine( wxDC &dc, char l)
 {
    unsigned int y;
    unsigned int sz;

    for( y = 0; y < 8; y++)	{
           if( l & 1) {
               dc.SetPen(wxPen(fgCol));
               dc.SetBrush(wxBrush(fgCol));
        } else {
               dc.SetPen(wxPen(bgCol));
               dc.SetBrush(wxBrush(bgCol));
        }

        for( sz = 0; sz < fontSz; sz++) {
            unsigned int ty = textY + sz + fontSz * y;

            if( ty >= height) { break; }

            if( l & 1) {
                buffer[ XY_TO_I(textX,ty) ] = fgCol565;
            } else {
                buffer[ XY_TO_I(textX,ty) ] = bgCol565;
            }

            setPixelOnDC( dc, textX, ty);
        }
        l = l >> 1;
    }

    textX++;
}

void LcdWidget::printIntGeneric( unsigned int val, int8_t neg, uint8_t width, uint8_t dot, char filler) {

    uint8_t bufflen = (width == 0) ? 6 : width;
    char buff[ bufflen+1 ];
    uint8_t p = bufflen;

    buff[p--] = '\0';

      // p >= 0 here
      if( val == 0) {
        buff[p] = '0';
      } else {
        for(;;) {
              buff[p] = (val % 10) + '0';
              val /= 10;
              if( val == 0 && dot == 0) { // done
                break;
              } else if( p == 0) {
                neg = -1; // indicates overflow
                break;
              }
        
              p--;

              if( dot > 0) {
                dot--;
                if( dot == 0) {
                    buff[p] = '.';
                    if( p == 0) {
                        break;
                    }
                    p--;
                }                
              }
        }
      }

      if( neg == 1) { // indicates negative sign
        if( p == 0) {
              neg = -1; // indicates overflow
        } else {
              p--;
          buff[p] = '-';
        }
      }
    
      if( neg < 0) { // indicates overflow
        for( p = 0; p < bufflen; p++) {
              buff[p] = '*'; 
        }
        p = 0;
      } else {
        if( width > 0) {
            while( p > 0) {
                p--;
                buff[p] = filler;
              }
        }
      }
    
      print( &buff[p] );
}

void LcdWidget::normalColors() {

    setBg(0,0,0);
    setFg(255,255,255);
}

void LcdWidget::selectedColors() {

    setBg(255,255,0);
    setFg(0,0,0);
}

void LcdWidget::headerColors() {

    setBg(0,0,0);
    setFg(0,255,0);
}

void LcdWidget::editColors() {

    setBg(255,255,255);
    setFg(0,0,0);
}

void LcdWidget::okColors() {

    setBg(0,0,0);
    setFg(0,255,0);
}

void LcdWidget::warnColors() {

    setBg(0,0,0);
    setFg(255,165,0);
}

void LcdWidget::alertColors() {

    setBg(0,0,0);
    setFg(255,0,0);
}

void LcdWidget::saveColors() {

    savedBgCol = bgCol565;
    savedFgCol = fgCol565;
}

void LcdWidget::restoreColors() {

    bgCol565 = savedBgCol;
    bgCol = col565ToCol(bgCol565);
    fgCol565 = savedFgCol;
    fgCol = col565ToCol(fgCol565);
}